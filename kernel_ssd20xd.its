## kernel_ssd20xd.its
```
/dts-v1/;

/ {
	description = "Sigmastar SSD20XD machines";
	#address-cells = <1>;

	images {
		kernel-0 {
			data = /incbin/("linux/arch/arm/boot/zImage");
			type = "kernel";
			arch = "arm";
			os = "linux";
			compression = "none";
			load = <0x22800000>;
                        entry = <0x22800000>;
			hash-0 {
				algo = "crc32";
			};
			hash-1 {
				algo = "sha1";
			};
		};
//		fdt@0 {
//			data = /incbin/("linux/arch/arm/boot/dts/mstar-infinity2m-ssd201-som2d01.dtb");
//			type = "flat_dt";
//			arch = "arm";
//			compression = "none";
//			load = <0x22d00000>;
//			hash-0 {
//				algo = "crc32";
//			};
//			hash-1 {
//				algo = "sha1";
//			};
//		};
//		fdt@1 {
//			data = /incbin/("linux/arch/arm/boot/dts/mstar-infinity2m-ssd202d-som2d01.dtb");
//			type = "flat_dt";
//			arch = "arm";
//			compression = "none";
//			load = <0x22d00000>;
//			hash-0 {
//				algo = "crc32";
//			};
//			hash-1 {
//				algo = "sha1";
//			};
//		};
		fdt_gw302 {
			data = /incbin/("linux/arch/arm/boot/dts/mstar-infinity2m-ssd202d-gw302.dtb");
			type = "flat_dt";
			arch = "arm";
			compression = "none";
			load = <0x22d00000>;
			hash-0 {
				algo = "crc32";
			};
			hash-1 {
				algo = "sha1";
			};
		};
		fdt_ssd201htv2 {
			data = /incbin/("linux/arch/arm/boot/dts/mstar-infinity2m-ssd202d-ssd201htv2.dtb");
			type = "flat_dt";
			arch = "arm";
			compression = "none";
			load = <0x22d00000>;
			hash-0 {
				algo = "crc32";
			};
			hash-1 {
				algo = "sha1";
			};
		};
		fdt_unitv2 {
			data = /incbin/("linux/arch/arm/boot/dts/mstar-infinity2m-ssd202d-unitv2.dtb");
			type = "flat_dt";
			arch = "arm";
			compression = "none";
			load = <0x22d00000>;
			hash-0 {
				algo = "crc32";
			};
			hash-1 {
				algo = "sha1";
			};
		};
		fdt_sbc2d06 {
			data = /incbin/("linux/arch/arm/boot/dts/mstar-infinity2m-ssd202d-wirelesstag-ido-sbc2d06-v1b-22w.dtb");
			type = "flat_dt";
			arch = "arm";
			compression = "none";
			load = <0x22d00000>;
			hash-0 {
				algo = "crc32";
			};
			hash-1 {
				algo = "sha1";
			};
		};
		fdt_dongshanpione {
			data = /incbin/("linux/arch/arm/boot/dts/mstar-infinity2m-ssd202d-100ask-dongshanpione.dtb");
			type = "flat_dt";
			arch = "arm";
			compression = "none";
			load = <0x22d00000>;
			hash-0 {
				algo = "crc32";
			};
			hash-1 {
				algo = "sha1";
			};
		};
	};

	configurations {
		default = "unitv2";
//		som2d01_ssd201 {
//			kernel = "kernel-0";
//			fdt = "fdt@0";
//		};
//		som2d01_ssd202 {
//			kernel = "kernel-0";
//			fdt = "fdt@1";
//		};
		gw302 {
			kernel = "kernel-0";
			fdt = "fdt_gw302";
		};
		ssd201htv2 {
			kernel = "kernel-0";
			fdt = "fdt_ssd201htv2";
		};
		sbc2d06 {
			kernel = "kernel-0";
			fdt = "fdt_sbc2d06";
		};
		unitv2 {
			kernel = "kernel-0";
			fdt = "fdt_unitv2";
		};
		dongshanpione {
			kernel = "kernel-0";
			fdt = "fdt_dongshanpione";
		};
	};
};
```
